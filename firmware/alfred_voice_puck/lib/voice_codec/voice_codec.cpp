// Implementation of the Opus voice encoder pipeline.
//
// SAL-4001 (P1.3). Builds on SAL-4000's audio_io which delivers 48 kHz
// stereo int32 blocks. This module turns those into 16 kHz mono Opus
// voice frames that SAL-4006 will ship over the WebSocket built in
// SAL-4002 / SAL-4003.
//
// Library choice: PlatformIO `sh123/esp32_opus` (LICENSE on the wrapper
// says GPL-3 but every source file under `src/` is upstream xiph BSD-3,
// confirmed by inspecting opus.c et al). Wrapper config sets
// FIXED_POINT and OPUS_BUILD which are correct for ESP32-S3; the float
// build is explicitly NOT what we want on this target. Vendoring the
// upstream opus-1.4 release tree is the documented Plan B in PLAN.md
// section 7 ticket 5; we picked the PIO library because it's the same
// upstream code with the right build flags already set, and it gets us
// to working firmware in one `pio run` instead of vendoring 198 files.
// If the licensing review later demands fully owning the source tree,
// drop in opus-1.4 under `lib/opus/` and remove the lib_deps entry.
//
// Anti-alias FIR: 11-tap Hamming-windowed sinc, fc ~7 kHz at the 48 kHz
// input rate, normalized to unity DC gain. Coefficients precomputed in
// Python. Suppression at the 16 kHz Nyquist (8 kHz) is ~25 dB which is
// adequate for VOIP-grade voice; aliasing into the 6-8 kHz band is mostly
// outside the speech formant range anyway. If we later push to wideband
// music we'll need a sharper kernel (or just stop downsampling and keep
// 48 kHz in the music path, which is already the plan).

#include "voice_codec.h"

#include <atomic>
#include <string.h>

#include "esp_log.h"
#include "opus.h"

namespace alfred {
namespace codec {

namespace {

constexpr const char* kTag = "voice_codec";

// 11-tap Hamming-windowed FIR low-pass, fc = 7 kHz at fs = 48 kHz.
// Generated by:
//   N = 11; fc = 7000; fs = 48000; ratio = 2*fc/fs
//   for n in range(N):
//     x = pi * (n - (N-1)/2)
//     h = ratio if n == (N-1)/2 else sin(ratio*x)/x
//     w = 0.54 - 0.46*cos(2*pi*n/(N-1))   # Hamming
//     coef = h * w
//   coefs /= sum(coefs)                   # normalize DC gain to 1.0
constexpr int kFirTaps = 11;
constexpr float kFirCoefs[kFirTaps] = {
  -0.0052004685f, -0.0068784554f, +0.0166377299f, +0.1080055805f,
  +0.2372388429f, +0.3003935410f, +0.2372388429f, +0.1080055805f,
  +0.0166377299f, -0.0068784554f, -0.0052004685f,
};

// FIR history: 10 samples = (kFirTaps - 1). Carries from one encode_block
// call to the next so the filter is continuous across block boundaries.
constexpr int kFirHistory = kFirTaps - 1;
float g_history[kFirHistory] = {0};

// Opus encoder handle. Allocated by opus_encoder_create at init.
OpusEncoder* g_enc = nullptr;
bool g_initialized = false;

// Stats. We update them only from the encoder task, but
// voice_codec_get_stats() may be called from the heartbeat task on core 0.
std::atomic<uint64_t> g_blocks_in{0};
std::atomic<uint64_t> g_frames_in{0};
std::atomic<uint64_t> g_frames_out{0};
std::atomic<uint64_t> g_bytes_out{0};
std::atomic<uint32_t> g_encode_overruns{0};
std::atomic<uint32_t> g_encode_errors{0};
std::atomic<uint32_t> g_max_encode_us{0};
std::atomic<uint32_t> g_last_encode_us{0};
std::atomic<uint32_t> g_last_payload_bytes{0};
std::atomic<uint32_t> g_avg_payload_bytes_x10{0};

// Scratch buffer for the int16 PCM the encoder consumes. 320 samples = 640 B.
// Static so we don't heap-thrash; this module is single-encoder-task only.
int16_t g_pcm16_mono[kVoiceFrameSamples] = {0};

}  // namespace

bool voice_codec_init() {
  if (g_initialized) {
    return true;
  }
  int err = OPUS_OK;
  g_enc = opus_encoder_create(static_cast<opus_int32>(kVoiceSampleRateHz),
                              kVoiceChannels,
                              OPUS_APPLICATION_VOIP, &err);
  if (g_enc == nullptr || err != OPUS_OK) {
    ESP_LOGE(kTag, "opus_encoder_create failed: %d", err);
    g_enc = nullptr;
    return false;
  }

  // VOIP defaults are mostly right; tighten the knobs that matter for our
  // 16 kHz / 24 kbps target. opus_encoder_ctl returns a negative code on
  // failure but a wrong knob is not fatal; log and proceed.
  auto setctl = [&](const char* name, int rc) {
    if (rc != OPUS_OK) {
      ESP_LOGW(kTag, "opus_encoder_ctl(%s) returned %d", name, rc);
    }
  };
  setctl("BITRATE",      opus_encoder_ctl(g_enc, OPUS_SET_BITRATE(static_cast<opus_int32>(kVoiceBitrateBps))));
  setctl("VBR",          opus_encoder_ctl(g_enc, OPUS_SET_VBR(1)));               // VBR on
  setctl("VBR_CONSTRAINT", opus_encoder_ctl(g_enc, OPUS_SET_VBR_CONSTRAINT(0)));  // unconstrained VBR
  setctl("COMPLEXITY",   opus_encoder_ctl(g_enc, OPUS_SET_COMPLEXITY(kVoiceComplexity)));
  setctl("SIGNAL",       opus_encoder_ctl(g_enc, OPUS_SET_SIGNAL(OPUS_SIGNAL_VOICE)));
  setctl("BANDWIDTH",    opus_encoder_ctl(g_enc, OPUS_SET_BANDWIDTH(OPUS_BANDWIDTH_WIDEBAND)));   // 8 kHz audio bw
  setctl("DTX",          opus_encoder_ctl(g_enc, OPUS_SET_DTX(1)));               // silence-suppress
  setctl("INBAND_FEC",   opus_encoder_ctl(g_enc, OPUS_SET_INBAND_FEC(1)));        // FEC for packet loss
  setctl("PACKET_LOSS",  opus_encoder_ctl(g_enc, OPUS_SET_PACKET_LOSS_PERC(5))); // assume 5% loss

  // Reset FIR state.
  memset(g_history, 0, sizeof(g_history));

  g_initialized = true;
  ESP_LOGI(kTag, "voice_codec up: %lu Hz %u ch, %lu ms frames, target %lu bps VBR, complexity %d",
           static_cast<unsigned long>(kVoiceSampleRateHz),
           kVoiceChannels,
           static_cast<unsigned long>(kVoiceFrameMs),
           static_cast<unsigned long>(kVoiceBitrateBps),
           kVoiceComplexity);
  return true;
}

bool voice_codec_encode_block(const int32_t* pcm_48k_stereo,
                              uint8_t* out_payload,
                              size_t* out_length) {
  if (!g_initialized || g_enc == nullptr || pcm_48k_stereo == nullptr ||
      out_payload == nullptr || out_length == nullptr) {
    return false;
  }
  *out_length = 0;
  g_blocks_in.fetch_add(1, std::memory_order_relaxed);
  g_frames_in.fetch_add(1, std::memory_order_relaxed);

  const uint32_t t0 = micros();

  // Step 1+2+3: select channel 0 (left), low-pass filter, decimate by 3,
  // shift int32 -> int16. We process all 320 output samples in a single
  // pass over the input. Each output sample requires 11 input taps
  // centered on input index (10 + 3*i). Indexes 0..9 of the convolution
  // window come from history; indexes 10..969 come from the current input
  // block.
  //
  // We scale each int32 sample to a float in [-1, 1] for filtering, then
  // back to int16. Using float here adds about 2.5 KB stack churn per
  // block which is fine; in production we'd swap to int16 fixed-point if
  // the FPU usage shows up in profiles. ESP32-S3 has a single-precision
  // FPU so this is hardware-accelerated.
  constexpr float kInt32ToUnit = 1.0f / 2147483648.0f;
  constexpr float kUnitToInt16 = 32767.0f;

  // Walk the 320 output samples. For each, compute a 11-tap dot product.
  for (size_t i = 0; i < kVoiceFrameSamples; ++i) {
    // Output sample i in 16 kHz domain corresponds to input index
    // 3*i in the 48 kHz channel-0 stream. The convolution window is
    // [3*i - 10 .. 3*i] in channel-0 terms; samples below 0 come from
    // history (size 10). For i=0, window is [-10..0] = all 10 history
    // taps + 1 input sample at channel-0 index 0.
    const int32_t base_in_ch0 = static_cast<int32_t>(3 * i);  // 0..957
    float acc = 0.0f;
    for (int k = 0; k < kFirTaps; ++k) {
      const int32_t src_idx = base_in_ch0 - (kFirTaps - 1 - k);  // -10..0 .. 957
      float s;
      if (src_idx < 0) {
        s = g_history[kFirHistory + src_idx];  // src_idx in -10..-1
      } else {
        // Channel 0 of stereo int32 input. Stride 2.
        s = static_cast<float>(pcm_48k_stereo[src_idx * 2]) * kInt32ToUnit;
      }
      acc += kFirCoefs[k] * s;
    }
    // Clamp and convert to int16. Saturating cast.
    if (acc >  1.0f) acc =  1.0f;
    if (acc < -1.0f) acc = -1.0f;
    g_pcm16_mono[i] = static_cast<int16_t>(acc * kUnitToInt16);
  }

  // Save the last 10 channel-0 samples of this input block as history for
  // the next call. The last 10 inputs touched were at indices 957..957
  // for the i=319 output; we need indices [kInputBlockFrames - kFirHistory ..
  // kInputBlockFrames - 1] = [950..959] in channel-0 terms.
  for (int k = 0; k < kFirHistory; ++k) {
    const size_t src_idx = kInputBlockFrames - kFirHistory + k;  // 950..959
    g_history[k] = static_cast<float>(pcm_48k_stereo[src_idx * 2]) * kInt32ToUnit;
  }

  // Step 4: Opus encode. opus_encode returns the number of bytes written
  // into out_payload, or a negative error code.
  const opus_int32 nb = opus_encode(g_enc, g_pcm16_mono,
                                    static_cast<int>(kVoiceFrameSamples),
                                    out_payload,
                                    static_cast<opus_int32>(kOpusMaxPayloadBytes));
  const uint32_t t1 = micros();
  const uint32_t dt = t1 - t0;
  g_last_encode_us.store(dt, std::memory_order_relaxed);
  uint32_t prev_max = g_max_encode_us.load(std::memory_order_relaxed);
  while (dt > prev_max && !g_max_encode_us.compare_exchange_weak(prev_max, dt)) {}
  // Encoder must keep up with realtime: 20 ms/frame at 1000 us/ms = 20000 us
  // budget. Anything slower means we'd starve audio_io's DMA and the next
  // 20 ms block arrives before we're done. Track as overrun.
  if (dt > 20000) {
    g_encode_overruns.fetch_add(1, std::memory_order_relaxed);
  }

  if (nb < 0) {
    g_encode_errors.fetch_add(1, std::memory_order_relaxed);
    ESP_LOGW(kTag, "opus_encode error: %ld", static_cast<long>(nb));
    return false;
  }
  // DTX: opus_encode can return 1 or 2 byte "no audio" frames or even 0
  // (omit). All are valid; downstream WS sender just ships whatever bytes
  // we hand it.
  *out_length = static_cast<size_t>(nb);
  g_frames_out.fetch_add(1, std::memory_order_relaxed);
  g_bytes_out.fetch_add(static_cast<uint64_t>(nb), std::memory_order_relaxed);
  g_last_payload_bytes.store(static_cast<uint32_t>(nb), std::memory_order_relaxed);

  // Rolling average bytes/frame * 10 (one decimal). EMA with alpha = 1/16
  // so it converges in ~16 frames = 320 ms.
  uint32_t prev_avg = g_avg_payload_bytes_x10.load(std::memory_order_relaxed);
  const uint32_t now_x10 = static_cast<uint32_t>(nb) * 10;
  const uint32_t new_avg = (prev_avg == 0) ? now_x10
                                            : (prev_avg + (now_x10 - prev_avg) / 16);
  g_avg_payload_bytes_x10.store(new_avg, std::memory_order_relaxed);

  return true;
}

CodecStats voice_codec_get_stats() {
  CodecStats s = {};
  s.blocks_in           = g_blocks_in.load(std::memory_order_relaxed);
  s.frames_in           = g_frames_in.load(std::memory_order_relaxed);
  s.frames_out          = g_frames_out.load(std::memory_order_relaxed);
  s.bytes_out           = g_bytes_out.load(std::memory_order_relaxed);
  s.encode_overruns     = g_encode_overruns.load(std::memory_order_relaxed);
  s.encode_errors       = g_encode_errors.load(std::memory_order_relaxed);
  s.max_encode_us       = g_max_encode_us.load(std::memory_order_relaxed);
  s.last_encode_us      = g_last_encode_us.load(std::memory_order_relaxed);
  s.last_payload_bytes  = g_last_payload_bytes.load(std::memory_order_relaxed);
  s.avg_payload_bytes_x10 = g_avg_payload_bytes_x10.load(std::memory_order_relaxed);
  return s;
}

}  // namespace codec
}  // namespace alfred
